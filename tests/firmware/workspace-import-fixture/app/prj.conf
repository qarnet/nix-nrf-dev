## CMakeLists.txt
```
cmake_minimum_required(VERSION 3.20)
# No EXTRA_ZEPHYR_MODULES: the application manifest must discover the module.
find_package(Zephyr REQUIRED)
project(workspace_import_fixture)
target_sources(app PRIVATE src/main.c)
```

## prj.conf
```kconfig
CONFIG_CONSOLE=n
CONFIG_SERIAL=n
CONFIG_LOG=n
CONFIG_PRINTK=n
```

## src/main.c
```c
/* SPDX-License-Identifier: MIT */
int source_import_fixture_value(void);

int main(void)
{
	/* The final link proves manifest-owned module discovery participated. */
	return source_import_fixture_value() == 41 ? 0 : 1;
}
```
